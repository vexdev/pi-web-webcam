## package/piwebcam/Config.in
```kconfig
config BR2_PACKAGE_PIWEBCAM
	bool "Raspberry Pi UVC Webcam"
	select BR2_PACKAGE_LIBV4L_UTILS
	select BR2_PACKAGE_V4L2LOOPBACK
	select BR2_PACKAGE_V4L2LOOPBACK_UTILS
	select BR2_PACKAGE_FFMPEG
	select BR2_PACKAGE_FFMPEG_SWSCALE
	select BR2_PACKAGE_FFMPEG_SWRESAMPLE
	select BR2_PACKAGE_FFMPEG_AVFILTER
	select BR2_PACKAGE_FFMPEG_AVDEVICE
	help
	  Install Raspberry Pi UVC Webcam package

	  https://github.com/peterbay/uvc-gadget
```
